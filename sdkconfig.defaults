## sdkconfig.defaults
```kconfig
CONFIG_IDF_TARGET="esp32"
CONFIG_ESPTOOLPY_FLASHSIZE_4MB=y
CONFIG_PARTITION_TABLE_SINGLE_APP=y
CONFIG_FREERTOS_HZ=100
CONFIG_ESP_CONSOLE_UART_BAUDRATE_115200=y
CONFIG_LOG_DEFAULT_LEVEL_INFO=y

CONFIG_ESP_WIFI_ENABLED=y
CONFIG_ESP_WIFI_STATIC_TX_BUFFER_NUM=16
CONFIG_ESP_WIFI_DYNAMIC_TX_BUFFER_NUM=32
CONFIG_ESP_WIFI_RX_BUFFER_NUM=16
CONFIG_ESP_WIFI_TX_BUFFER_TYPE=1
CONFIG_ESP_WIFI_AMPDU_TX_ENABLED=n
CONFIG_ESP_WIFI_AMPDU_RX_ENABLED=n

CONFIG_HTTPD_MAX_REQ_HDR_LEN=512
CONFIG_HTTPD_MAX_URI_LEN=512
CONFIG_HTTPD_WS_SUPPORT=y

CONFIG_SPI_FLASH_SUPPORT_ISSI_CHIP=y

CONFIG_SDMMC_SUPPORT_SPI=y
CONFIG_SDMMC_ENABLE_SPI_DEFAULT=y
CONFIG_FATFS_MAX_LFN=64
CONFIG_FATFS_LFN_NONE=n
CONFIG_FATFS_LFN_HEAP=y
CONFIG_FATFS_API_ENCODING_UTF8=y
```
